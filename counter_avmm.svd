# MU3E_COUNTER_AVMM register map
Vendor: Mu3e; Series: MU3E_FPGA_IP; File version: 1.4.1
CMSIS-SVD description of the counter_avmm value aperture. This first-pass contract exposes the 32-word relative window as read-only counter words; write-side clear semantics can be added later by the IP author if they are meant to be operator-visible.
Registers are 32-bit, read-only, reset 0x0 unless marked. A register's access mark holds for its fields unless they carry their own. Offsets are from the block's base; lines under a group give offsets from that group; [hi:lo] are bit positions; {n}, {i} and the like mark numbered series; 'fields as' and 'values as' point back to an identical list; <NAME> marks a mode.

## Memory map
0x00000000 COUNTER_AVMM_VALUE size 0x80 — Relative 32-word counter-value aperture.

## COUNTER_AVMM_VALUE — Relative 32-word counter-value aperture.
Base 0x00000000
{0x0+4i} WORD{i:03} (i=0..31) — Counter AVMM word {i}.
  [31:0] value — Raw counter AVMM word {i}.
